## conf/machine/include/package_revision.inc
```bitbake
PV_pn-rdkresident-app= "1.0.0"
PR_pn-rdkresident-app= "r0"
PACKAGE_ARCH_pn-lib32-rdkresident-app = "${APPLICATION_LAYER_ARCH}"

PV_pn-residentui= "1.0.0"
PR_pn-residentui= "r0"
PACKAGE_ARCH_pn-lib32-residentui = "${APPLICATION_LAYER_ARCH}"
```
